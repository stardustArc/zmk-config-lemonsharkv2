## boards/shields/lemonshark/Kconfig.shield
```kconfig
config SHIELD_LEMONSHARK_LEFT
    def_bool $(shields_list_contains,lemonshark_left)

config SHIELD_LEMONSHARK_RIGHT
    def_bool $(shields_list_contains,lemonshark_right)
```
